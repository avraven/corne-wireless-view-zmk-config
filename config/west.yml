## config/west.yml
```yaml
manifest:
  remotes:
    - name: zmkfirmware
      url-base: https://github.com/zmkfirmware
  projects:
    - name: zmk
      remote: zmkfirmware
      revision: main
      import: app/west.yml
      import: app/src/display/Kconfig
      import: app/src/display/widgets/Kconfig
  self:
    path: config
```
